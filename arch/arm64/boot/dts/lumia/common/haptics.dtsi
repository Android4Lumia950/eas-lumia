/* Copyright (c) 2014-2015, The Linux Foundation. All rights reserved.
 *
 * This program is free software; you can redistribute it and/or modify
 * it under the terms of the GNU General Public License version 2 and
 * only version 2 as published by the Free Software Foundation.
 *
 * This program is distributed in the hope that it will be useful,
 * but WITHOUT ANY WARRANTY; without even the implied warranty of
 * MERCHANTABILITY or FITNESS FOR A PARTICULAR PURPOSE.  See the
 * GNU General Public License for more details.
 */

 &pmi8994_haptics {
	status = "okay";
	qcom,actuator-type = "erm";
	qcom,vmax-mv = <2300>;
	qcom,ilim-ma = <800>;
	qcom,sc-deb-cycles = <8>;
	qcom,int-pwm-freq-khz = <505>;
	qcom,wave-shape = "square";
	qcom,lra-auto-res-mode = "none";
	qcom,lra-high-z = "none";
	qcom,lra-res-cal-period = <4>;
	qcom,use-sc-irq;
	qcom,brake-pattern = [ 00 11 11 11 ];
};