/* Copyright (c) 2014-2015, The Linux Foundation. All rights reserved.
 *
 * This program is free software; you can redistribute it and/or modify
 * it under the terms of the GNU General Public License version 2 and
 * only version 2 as published by the Free Software Foundation.
 *
 * This program is distributed in the hope that it will be useful,
 * but WITHOUT ANY WARRANTY; without even the implied warranty of
 * MERCHANTABILITY or FITNESS FOR A PARTICULAR PURPOSE.  See the
 * GNU General Public License for more details.
 */

 &soc {
	i2c@f9923000 {
		status = "ok"; // enable on 950XL

    	qcom,clk-freq-out = <400000>;
    	qcom,disable-dma;
    	synaptics@4b {
    		status = "ok";
    		compatible = "synaptics,rmi4";
    		reg = <0x4b>;
    		interrupt-parent = <&msm_gpio>;
    		interrupts = <77 0x2008>;
    		vcc_i2c-supply = <&pm8994_lvs1>;
    		vdd-supply = <&pm8994_l22>;
    		synaptics,reset-gpio = <&msm_gpio 38 0x00>;
    		synaptics,irq-gpio = <&msm_gpio 77 0x2008>;
    		synaptics,i2c-pull-up;
    		synaptics,power-down;
    		synaptics,check-build;
    		synaptics,pon-delay = <66>;
    		synaptics,disable-gpios;
    		synaptics,display-coords = <0 0 1439 2559>;
    		synaptics,num-of-tx = <28>;
    		synaptics,num-of-rx = <16>;
    		synaptics,num-of-fingers = <10>;

			pinctrl-names = "pmx_ts_active", "pmx_ts_suspend";
			pinctrl-0 = <&ts_active>;
			pinctrl-1 = <&ts_suspend>;
    	};
	};
};
