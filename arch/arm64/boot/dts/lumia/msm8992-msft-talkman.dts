/* Copyright (c) 2014, The Linux Foundation. All rights reserved.
 *
 * This program is free software; you can redistribute it and/or modify
 * it under the terms of the GNU General Public License version 2 and
 * only version 2 as published by the Free Software Foundation.
 *
 * This program is distributed in the hope that it will be useful,
 * but WITHOUT ANY WARRANTY; without even the implied warranty of
 * MERCHANTABILITY or FITNESS FOR A PARTICULAR PURPOSE.  See the
 * GNU General Public License for more details.
 */


/dts-v1/;

#include "../qcom/msm8992.dtsi"
#include "../qcom/msm8992-pinctrl.dtsi"
#include "msm8992-chi.dtsi"

/ {
	model = "Microsoft Lumia 950";
	compatible = "qcom,msm8992-talkman", "qcom,msm8992", "qcom,talkman";
	qcom,msm-id = <0xfb 00010000 0x0001001a 0>;
	qcom,board-id = <26 0>;
	qcom,pmic-id = <0x20009 0x2000a 0x0 0x0>;
};
