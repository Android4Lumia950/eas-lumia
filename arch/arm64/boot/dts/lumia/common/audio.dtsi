/* Copyright (c) 2014-2015, The Linux Foundation. All rights reserved.
 *
 * This program is free software; you can redistribute it and/or modify
 * it under the terms of the GNU General Public License version 2 and
 * only version 2 as published by the Free Software Foundation.
 *
 * This program is distributed in the hope that it will be useful,
 * but WITHOUT ANY WARRANTY; without even the implied warranty of
 * MERCHANTABILITY or FITNESS FOR A PARTICULAR PURPOSE.  See the
 * GNU General Public License for more details.
 */
 
&soc {
	sound {
		qcom,audio-routing =
			"AIF4 VI", "MCLK",
			"RX_BIAS", "MCLK",
			"LDO_H", "MCLK",
			"MADINPUT", "MCLK",
			"ultrasound amp", "LINEOUT1",
			"ultrasound amp", "LINEOUT3",
			"AMIC1", "MIC BIAS1 Internal1",
			"MIC BIAS1 Internal1", "Handset Mic",
			"AMIC2", "MIC BIAS2 External",
			"MIC BIAS2 External", "Headset Mic",
			"AMIC3", "MIC BIAS2 External",
			"MIC BIAS2 External", "ANCRight Headset Mic",
			"AMIC4", "MIC BIAS2 External",
			"MIC BIAS2 External", "ANCLeft Headset Mic",
			"AMIC5", "MIC BIAS3 External",
			"MIC BIAS3 External", "Analog Mic5",
			"AMIC6", "MIC BIAS4 External",
			"MIC BIAS4 External", "Analog Mic6",
			"DMIC1", "MIC BIAS1 External",
			"MIC BIAS1 External", "Digital Mic1",
			"DMIC2", "MIC BIAS1 External",
			"MIC BIAS1 External", "Digital Mic2",
			"DMIC3", "MIC BIAS3 External",
			"MIC BIAS3 External", "Digital Mic3",
			"DMIC4", "MIC BIAS3 External",
			"MIC BIAS3 External", "Digital Mic4",
			"DMIC5", "MIC BIAS4 External",
			"MIC BIAS4 External", "Digital Mic5",
			"DMIC6", "MIC BIAS4 External",
			"MIC BIAS4 External", "Digital Mic6";

		qcom,us-euro-gpios = <&pm8994_mpps 2 0>;
		qcom,cdc-micbias2-headset-only;
		qcom,mbhc-audio-jack-type = "4-pole-jack";
		qcom,ext-ult-spk-amp-gpio = <&pmi8994_gpios 1 0>;
		asoc-codec = <&stub_codec>;
		asoc-codec-names = "msm-stub-codec.1";
	};
};

&slim_msm {
	tomtom_codec {
		qcom,cdc-micbias1-ext-cap;
		qcom,cdc-micbias3-ext-cap;
		qcom,cdc-micbias4-ext-cap;
		cdc-vdd-spkdrv-supply = <&pmi8994_boost_pin_ctrl>;
		qcom,cdc-vdd-spkdrv-voltage = <5000000 5000000>;
		qcom,cdc-vdd-spkdrv-current = <600000>;

		cdc-vdd-spkdrv-2-supply = <&pmi8994_boost_pin_ctrl>;
		qcom,cdc-vdd-spkdrv-2-voltage = <5000000 5000000>;
		qcom,cdc-vdd-spkdrv-2-current = <600000>;

		qcom,cdc-on-demand-supplies = "cdc-vdd-spkdrv",
					      "cdc-vdd-spkdrv-2";
	};
};