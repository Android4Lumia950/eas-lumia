/* Copyright (c) 2014-2015, The Linux Foundation. All rights reserved.
 *
 * This program is free software; you can redistribute it and/or modify
 * it under the terms of the GNU General Public License version 2 and
 * only version 2 as published by the Free Software Foundation.
 *
 * This program is distributed in the hope that it will be useful,
 * but WITHOUT ANY WARRANTY; without even the implied warranty of
 * MERCHANTABILITY or FITNESS FOR A PARTICULAR PURPOSE.  See the
 * GNU General Public License for more details.
 */

&mdss_mdp {
	qcom,mdss-pref-prim-intf = "dsi";
};

&pmx_mdss {
	qcom,num-grp-pins = <1>;
	qcom,pins = <&gp 78>;
};

&pmx_mdss_te {
	qcom,num-grp-pins = <1>;
	qcom,pins = <&gp 10>;
};

&mdss_dsi0 {
    //panel name will be included from the dtsi
	pinctrl-names = "mdss_default", "mdss_sleep";
	pinctrl-0 = <&mdss_dsi_active &mdss_te_active>;
	pinctrl-1 = <&mdss_dsi_suspend &mdss_te_suspend>;

	qcom,platform-reset-gpio = <&msm_gpio 78 0>;
	qcom,platform-te-gpio = <&msm_gpio 10 0>;

	vddio-supply = <&pm8994_s4>;
};