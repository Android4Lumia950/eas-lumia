/ {
	aliases {
		i2c7 = &i2c_7;
	};
};

&soc {
	i2c_7: i2c@f9963000 { /* BLSP1 QUP6 */
		compatible = "qcom,i2c-msm-v2";
		#address-cells = <1>;
		#size-cells = <0>;
		status = "disabled";
		reg-names = "qup_phys_addr";
		reg = <0xf9963000 0x800>;
		interrupt-names = "qup_irq";
		interrupts = <0 101 0>;
		qcom,clk-freq-out = <400000>;
		qcom,clk-freq-in  = <19200000>;
		clock-names = "iface_clk", "core_clk";
		clocks = <&clock_gcc clk_gcc_blsp2_ahb_clk>,
			 <&clock_gcc clk_gcc_blsp2_qup1_i2c_apps_clk>;

		pinctrl-names = "i2c_active", "i2c_sleep";
		pinctrl-0 = <&i2c_6_active>;
		pinctrl-1 = <&i2c_6_sleep>;
		qcom,noise-rjct-scl = <0>;
		qcom,noise-rjct-sda = <0>;
		dmas = <&dma_blsp2 22 64 0x20000020 0x20>,
			<&dma_blsp2 23 32 0x20000020 0x20>;
		dma-names = "tx", "rx";
		qcom,master-id = <86>;
	};
};