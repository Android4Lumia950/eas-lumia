/* Copyright (c) 2017, The Linux Foundation. All rights reserved.
 *
 * This program is free software; you can redistribute it and/or modify
 * it under the terms of the GNU General Public License version 2 and
 * only version 2 as published by the Free Software Foundation.
 *
 * This program is distributed in the hope that it will be useful,
 * but WITHOUT ANY WARRANTY; without even the implied warranty of
 * MERCHANTABILITY or FITNESS FOR A PARTICULAR PURPOSE.  See the
 * GNU General Public License for more details.
 */

/*---------------------------------------------------------------------------
 * This file is autogenerated file using gcdb parser. Please do not edit it.
 * Update input XML file to add a new entry or update variable in this file
 * VERSION = "1.0"
 *---------------------------------------------------------------------------*/
&mdss_mdp {
	dsi_duke_wqhd_dsi0_cmd: qcom,mdss_dsi_duke_wqhd_dsi0_cmd {
		qcom,mdss-dsi-panel-name = "Duke 1440p DSI0 cmd mode panel";
		qcom,mdss-dsi-panel-controller = <&mdss_dsi0>;
		qcom,mdss-dsi-panel-type = "dsi_cmd_mode";
		qcom,mdss-dsi-panel-destination = "display_1";
		qcom,mdss-dsi-panel-framerate = <60>;
		qcom,mdss-dsi-virtual-channel-id = <0>;
		qcom,mdss-dsi-stream = <0>;
		qcom,mdss-dsi-panel-width = <720>;
		qcom,mdss-dsi-panel-height = <2560>;
		qcom,mdss-dsi-h-front-porch = <76>;
		qcom,mdss-dsi-h-back-porch = <32>;
		qcom,mdss-dsi-h-pulse-width = <16>;
		qcom,mdss-dsi-h-sync-skew = <0>;
		qcom,mdss-dsi-v-back-porch = <2>;
		qcom,mdss-dsi-v-front-porch = <4>;
		qcom,mdss-dsi-v-pulse-width = <2>;
		qcom,mdss-dsi-h-left-border = <0>;
		qcom,mdss-dsi-h-right-border = <0>;
		qcom,mdss-dsi-v-top-border = <0>;
		qcom,mdss-dsi-v-bottom-border = <0>;
		qcom,mdss-dsi-bpp = <24>;
		qcom,mdss-dsi-color-order = "rgb_swap_rgb";
		qcom,mdss-dsi-underflow-color = <0xff>;
		qcom,mdss-dsi-border-color = <0>;
		qcom,mdss-dsi-h-sync-pulse = <32>;
		qcom,mdss-dsi-traffic-mode = "burst_mode";
		qcom,mdss-dsi-lane-map = "lane_map_0123";
		qcom,mdss-dsi-lane-hs = <1>;
		qcom,mdss-dsi-bllp-eof-power-mode;
		qcom,mdss-dsi-bllp-power-mode;
		qcom,ulps-enabled;
		qcom,cmd-sync-wait-broadcast;
		// qcom,cont-splash-enabled;
		qcom,mdss-dsi-lane-0-state;
		qcom,mdss-dsi-lane-1-state;
		qcom,mdss-dsi-lane-2-state;
		qcom,mdss-dsi-lane-3-state;


		qcom,mdss-dsi-panel-timings = [97 5A 3E 00 9A 9A 48 5E 4B 03 04 00];
		qcom,mdss-dsi-reset-sequence = <1 17>, <0 17>, <1 17>;
		qcom,mdss-dsi-t-clk-post = <0x5>;
		qcom,mdss-dsi-t-clk-pre = <0x5e>;
    	 qcom,dynamic-dsi-timing-enable;
		qcom,mdss-dsi-bl-min-level = <15>;
		qcom,mdss-dsi-bl-max-level = <255>;
		qcom,mdss-dsi-bl-pmic-control-type = "bl_ctrl_dcs";

		qcom,mdss-dsi-dma-trigger = "trigger_sw";
		qcom,mdss-dsi-mdp-trigger = "none";
		qcom,mdss-dsi-te-pin-select = <1>;
		qcom,mdss-dsi-wr-mem-start = <0x2c>;
		qcom,mdss-dsi-wr-mem-continue = <0x3c>;
		qcom,mdss-dsi-te-dcs-command = <1>;
		qcom,mdss-dsi-te-check-enable;
		qcom,mdss-dsi-te-using-te-pin;
		qcom,mdss-dsi-on-command = [
			/* exit_sleep_mode, wait 120ms */
	   		05 01 00 00 78 00 02 11 00 
			/* duke_unlock_level */
	   		39 01 00 00 00 00 03 F0 5A 5A 
       		39 01 00 00 00 00 04 BD 05 02 16 
			/* page select?*/
       		15 01 00 00 00 00 02 FF 02	
			/* duke_lock_level */
       		39 01 00 00 00 00 03 F0 A5 A5 
			/* write ctrl display */
       		15 01 00 00 00 00 02 53 20 
			/* write display brightness */
       		15 01 00 00 00 00 02 51 80 
			/* set tear on */
       		15 01 00 00 00 00 02 35 00
			/* set_display_on */
       		05 01 00 00 00 00 02 29 00
			];

		qcom,mdss-dsi-on-command-state = "dsi_lp_mode";
		qcom,mdss-dsi-off-command = [
			/* set_display_off */
			05 01 00 00 21 00 02 28 00
			/* set_idle_on */
       		05 01 00 00 78 00 02 10 00
			];
		qcom,mdss-dsi-off-command-state = "dsi_hs_mode";
		qcom,mdss-dsi-hbm-on-command = [
			/* HBM setting in 2 MSB bits of reg 53 */
			15 01 00 00 00 00 03 53 e0 00
			];

		qcom,mdss-dsi-hbm-off-command = [
       		15 01 00 00 00 00 02 53 20 
			];
		qcom,mdss-pan-physical-width-dimension = <65>;
		qcom,mdss-pan-physical-height-dimension = <115>;
		qcom,panel-roi-alignment = <8 8 1 1 1 1>;
		qcom,partial-update-enabled;
		qcom,partial-update-roi-merge;
	};
	
	dsi_duke_wqhd_dsi1_cmd: qcom,mdss_dsi_duke_wqhd_dsi1_cmd {
		qcom,mdss-dsi-panel-name = "Duke 1440p DSI1 cmd mode panel";
		qcom,mdss-dsi-panel-controller = <&mdss_dsi1>;
		qcom,mdss-dsi-panel-type = "dsi_cmd_mode";
		qcom,mdss-dsi-panel-destination = "display_2";
		qcom,mdss-dsi-panel-framerate = <60>;
		qcom,mdss-dsi-virtual-channel-id = <0>;
		qcom,mdss-dsi-stream = <0>;
		qcom,mdss-dsi-panel-width = <720>;
		qcom,mdss-dsi-panel-height = <2560>;
		qcom,mdss-dsi-h-front-porch = <76>;
		qcom,mdss-dsi-h-back-porch = <32>;
		qcom,mdss-dsi-h-pulse-width = <16>;
		qcom,mdss-dsi-h-sync-skew = <0>;
		qcom,mdss-dsi-v-back-porch = <2>;
		qcom,mdss-dsi-v-front-porch = <4>;
		qcom,mdss-dsi-v-pulse-width = <2>;
		qcom,mdss-dsi-h-left-border = <0>;
		qcom,mdss-dsi-h-right-border = <0>;
		qcom,mdss-dsi-v-top-border = <0>;
		qcom,mdss-dsi-v-bottom-border = <0>;
		qcom,mdss-dsi-bpp = <24>;
		qcom,mdss-dsi-color-order = "rgb_swap_rgb";
		qcom,mdss-dsi-underflow-color = <0xff>;
		qcom,mdss-dsi-border-color = <0>;
		qcom,mdss-dsi-h-sync-pulse = <32>;
		qcom,mdss-dsi-traffic-mode = "burst_mode";
		qcom,mdss-dsi-lane-map = "lane_map_0123";
		qcom,mdss-dsi-lane-hs = <1>;
		qcom,mdss-dsi-bllp-eof-power-mode;
		qcom,mdss-dsi-bllp-power-mode;
		qcom,ulps-enabled;
		qcom,cmd-sync-wait-broadcast;
		qcom,cmd-sync-wait-trigger;
		// qcom,cont-splash-enabled;
		qcom,mdss-dsi-lane-0-state;
		qcom,mdss-dsi-lane-1-state;
		qcom,mdss-dsi-lane-2-state;
		qcom,mdss-dsi-lane-3-state;


		qcom,mdss-dsi-panel-timings = [97 5A 3E 00 9A 9A 48 5E 4B 03 04 00];
		qcom,mdss-dsi-reset-sequence = <1 17>, <0 17>, <1 17>;
		qcom,mdss-dsi-t-clk-post = <0x5>;
		qcom,mdss-dsi-t-clk-pre = <0x5e>;
        qcom,dynamic-dsi-timing-enable;
		qcom,mdss-dsi-bl-min-level = <15>;
		qcom,mdss-dsi-bl-max-level = <255>;
		qcom,mdss-dsi-bl-pmic-control-type = "bl_ctrl_dcs";
		
		qcom,mdss-dsi-dma-trigger = "trigger_sw";
		qcom,mdss-dsi-mdp-trigger = "none";
		qcom,mdss-dsi-te-pin-select = <1>;
		qcom,mdss-dsi-wr-mem-start = <0x2c>;
		qcom,mdss-dsi-wr-mem-continue = <0x3c>;
		qcom,mdss-dsi-te-dcs-command = <1>;
		qcom,mdss-dsi-te-check-enable;
		qcom,mdss-dsi-te-using-te-pin;
		qcom,mdss-dsi-on-command = [
			/* exit_sleep_mode, wait 120ms */
	   		05 01 00 00 78 00 02 11 00 
			/* duke_unlock_level */
	   		39 01 00 00 00 00 03 F0 5A 5A 
       		39 01 00 00 00 00 04 BD 05 02 16 
			/* page select?*/
       		15 01 00 00 00 00 02 FF 02	
			/* duke_lock_level */
       		39 01 00 00 00 00 03 F0 A5 A5 
			/* write ctrl display */
       		15 01 00 00 00 00 02 53 20 
			/* write display brightness */
       		15 01 00 00 00 00 02 51 80 
			/* set tear on */
       		15 01 00 00 00 00 02 35 00
			/* set_display_on */
       		05 01 00 00 00 00 02 29 00
			];

		qcom,mdss-dsi-on-command-state = "dsi_lp_mode";
		qcom,mdss-dsi-off-command = [
			/* set_display_off */
			05 01 00 00 21 00 02 28 00
			/* set_idle_on */
       		05 01 00 00 78 00 02 10 00
			];
		qcom,mdss-dsi-off-command-state = "dsi_hs_mode";
		qcom,mdss-pan-physical-width-dimension = <65>;
		qcom,mdss-pan-physical-height-dimension = <115>;
		qcom,panel-roi-alignment = <8 8 1 1 1 1>;
		qcom,partial-update-enabled;
		qcom,partial-update-roi-merge;
	};
};
