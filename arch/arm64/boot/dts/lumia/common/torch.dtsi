/* 
 * A simple LED controlled by the LED_GPIO base driver.
 * According to the schematic, the main pin is located on processor under the GPIO_12 pin.
 *
 */

/ {
	leds {
		compatible = "gpio-leds";
		flashlight {
			label = "led::flash_torch";
			gpios = <&msm_gpio 12 0>;
			default-state = "off";
			linux,default-trigger = "none";
			retain-state-suspended;
		};
	};
};
